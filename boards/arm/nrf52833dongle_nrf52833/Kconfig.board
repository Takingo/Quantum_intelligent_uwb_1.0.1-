## boards/arm/nrf52833dongle_nrf52833/Kconfig.board
```kconfig
# SPDX-License-Identifier: Apache-2.0

config BOARD_NRF52833DONGLE_NRF52833
	bool "nRF52833 Dongle (K4W UWB Tag)"
	depends on SOC_NRF52833_QDAA
```

## boards/arm/nrf52833dongle_nrf52833/Kconfig.defconfig
```kconfig
# SPDX-License-Identifier: Apache-2.0

if BOARD_NRF52833DONGLE_NRF52833

config BOARD
	default "nrf52833dongle_nrf52833"

endif # BOARD_NRF52833DONGLE_NRF52833
```

## boards/arm/nrf52833dongle_nrf52833/nrf52833dongle_nrf52833_defconfig
```kconfig
# K4W UWB Tag Configuration

CONFIG_SOC_SERIES_NRF52X=y
CONFIG_SOC_NRF52833_QDAA=y
CONFIG_BOARD_NRF52833DONGLE_NRF52833=y

# Enable MPU
CONFIG_ARM_MPU=y

# Enable hardware stack protection
CONFIG_HW_STACK_PROTECTION=y

# Enable GPIO
CONFIG_GPIO=y

# Enable console
CONFIG_CONSOLE=y
CONFIG_UART_CONSOLE=y
```
